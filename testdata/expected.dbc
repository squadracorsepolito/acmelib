VERSION "_"

NS_ :

BS_:

BU_: node_0 rec_node_0

VAL_TABLE_ enum 0 "VALUE_0" 1 "VALUE_1" 15 "VALUE_15";

BO_ 16 msg_0 : 8 node_0
 SG_ std_sig_0 : 0|4@1+ (1,0) [0|15] "degC" Vector__XXX
 SG_ mux_sig_0 M : 4|2@1+ (1,0) [0|3] "" Vector__XXX
 SG_ fixed_sig m0 : 6|4@1+ (1,0) [0|15] "" Vector__XXX
 SG_ multi_group_sig_0 m0 : 10|4@1+ (1,0) [0|15] "" Vector__XXX
 SG_ one_group_sig_0 m1 : 10|4@1+ (1,0) [0|15] "" Vector__XXX

BO_ 32 msg_1 : 8 node_0
 SG_ mux_sig_1 M : 0|2@1+ (1,0) [0|3] "" Vector__XXX
 SG_ one_group_sig_1 m0 : 2|4@1+ (1,0) [0|15] "" Vector__XXX
 SG_ nested_mux_sig_1 m0M : 2|1@1+ (1,0) [0|1] "" Vector__XXX
 SG_ one_group_sig_2 m0 : 3|4@1+ (1,0) [0|15] "" Vector__XXX
 SG_ multi_group_sig_1 m1 : 7|4@1+ (1,0) [0|15] "" Vector__XXX

BO_ 48 msg_2 : 8 node_0
 SG_ enum_sig_0 : 0|4@1+ (1,0) [0|15] "" rec_node_0

BO_ 64 msg_3 : 1 node_0
 SG_ std_sig_1 : 7|4@0+ (1,0) [0|15] "" Vector__XXX
 SG_ std_sig_2 : 3|4@0+ (1,0) [0|15] "" Vector__XXX

BO_ 128 mux_fixed_1l_std_sig_msg : 3 node_0
 SG_ muxor_sig M : 0|1@1+ (1,0) [0|2] "" Vector__XXX
 SG_ fixed_sig_0 : 1|4@1+ (1,0) [0|15] "" Vector__XXX
 SG_ muxed_sig_0_0 m0 : 5|4@1+ (1,0) [0|15] "" Vector__XXX
 SG_ muxed_sig_1_0 m1 : 5|4@1+ (1,0) [0|15] "" Vector__XXX
 SG_ fixed_sig_1 : 9|4@1+ (1,0) [0|15] "" Vector__XXX
 SG_ muxed_sig_0_1 m0 : 13|4@1+ (1,0) [0|15] "" Vector__XXX
 SG_ muxed_sig_1_1 m1 : 13|4@1+ (1,0) [0|15] "" Vector__XXX
 SG_ std_sig : 17|4@1+ (1,0) [0|15] "" Vector__XXX

CM_ "bus0 description";
CM_ BU_ node_0 "node0 description";
CM_ BO_ 32 "msg1 description";
CM_ SG_ 32 mux_sig_1 "mux1 description";

BA_DEF_ "str_att" STRING;
BA_DEF_ BU_ "int_att" INT 0 10000;
BA_DEF_ BO_ "hex_att" HEX 0 10000;
BA_DEF_ SG_ "enum_att" ENUM "VALUE_0", "VALUE_1", "VALUE_2", "VALUE_3";
BA_DEF_ SG_ "float_att" FLOAT 0 100.5;
BA_DEF_ BO_ "GenMsgCycleTime" INT 0 3600000;
BA_DEF_ BO_ "GenMsgDelayTime" INT 0 1000;
BA_DEF_ BO_ "GenMsgStartDelayTime" INT 0 100000;
BA_DEF_ BO_ "GenMsgSendType" ENUM "NoMsgSendType", "Cyclic", "CyclicIfActive", "CyclicAndTriggered", "CyclicIfActiveAndTriggered";
BA_DEF_ SG_ "GenSigSendType" ENUM "NoSigSendType", "Cyclic", "OnWrite", "OnWriteWithRepetition", "OnChange", "OnChangeWithRepetition", "IfActive", "IfActiveWithRepetition";

BA_DEF_DEF_ "str_att" "";
BA_DEF_DEF_ "int_att" 0;
BA_DEF_DEF_ "hex_att" 0;
BA_DEF_DEF_ "enum_att" "VALUE_0";
BA_DEF_DEF_ "float_att" "";
BA_DEF_DEF_ "GenMsgCycleTime" 0;
BA_DEF_DEF_ "GenMsgDelayTime" 0;
BA_DEF_DEF_ "GenMsgStartDelayTime" 0;
BA_DEF_DEF_ "GenMsgSendType" "NoMsgSendType";
BA_DEF_DEF_ "GenSigSendType" "NoSigSendType";

BA_ "str_att" "bus0_value";
BA_ "int_att" BU_ node_0 1;
BA_ "hex_att" BO_ 16 1;
BA_ "enum_att" SG_ 16 std_sig_0 1;
BA_ "float_att" SG_ 16 mux_sig_0 50.75;
BA_ "GenMsgCycleTime" BO_ 48 10;
BA_ "GenMsgDelayTime" BO_ 48 20;
BA_ "GenMsgStartDelayTime" BO_ 48 30;
BA_ "GenMsgSendType" BO_ 48 4;
BA_ "GenSigSendType" SG_ 48 enum_sig_0 5;

VAL_ 48 enum_sig_0 0 "VALUE_0" 1 "VALUE_1" 15 "VALUE_15";

SG_MUL_VAL_ 16 fixed_sig mux_sig_0 0-3;
SG_MUL_VAL_ 16 multi_group_sig_0 mux_sig_0 0-0, 2-3;
SG_MUL_VAL_ 32 one_group_sig_2 nested_mux_sig_1 0-0;
SG_MUL_VAL_ 32 multi_group_sig_1 nested_mux_sig_1 0-1;
SG_MUL_VAL_ 32 one_group_sig_1 mux_sig_1 0-0;
SG_MUL_VAL_ 32 nested_mux_sig_1 mux_sig_1 1-1;
