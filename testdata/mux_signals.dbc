VERSION "_"

NS_ :

BS_:

BU_: node_0

BO_ 16 msg_0 : 8 node_0
 SG_ ovrd_cmd M : 0|2@1+ (1,0) [0|3] "" Vector__XXX
 SG_ DADD : 2|6@1+ (1,0) [0|63] "" Vector__XXX
 SG_ CADD : 8|3@1+ (1,0) [0|7] "" Vector__XXX
 SG_ ovrd_bank : 11|2@1+ (1,0) [0|3] "" Vector__XXX
 SG_ ovrd_bank_enabled m2 : 13|1@1+ (1,0) [0|1] "" Vector__XXX
 SG_ ovrd_bitset_idx m1 : 13|3@1+ (1,0) [0|7] "" Vector__XXX
 SG_ write_RADD m0 : 16|13@1+ (1,0) [0|8191] "" Vector__XXX
 SG_ ovrd_bitset m1 : 16|48@1+ (1,0) [0|281474976710655] "" Vector__XXX
 SG_ read_RADD m3 : 16|13@1+ (1,0) [0|8191] "" Vector__XXX
 SG_ value m0 : 32|16@1+ (1,0) [0|65535] "" Vector__XXX
